## boards/shields/ergokeeb_corne/Kconfig.defconfig
```kconfig
if SHIELD_ERGOKEEB_CORNE_LEFT

config ZMK_KEYBOARD_NAME
    default "ErgoKeeb Corne"

config ZMK_SPLIT_ROLE_CENTRAL
    default y

endif

if SHIELD_ERGOKEEB_CORNE_LEFT || SHIELD_ERGOKEEB_CORNE_RIGHT

config ZMK_SPLIT
    default y

endif
```

## boards/shields/ergokeeb_corne/Kconfig.shield
```kconfig
config SHIELD_ERGOKEEB_CORNE_LEFT
    def_bool $(shields_list_contains,ergokeeb_corne_left)

config SHIELD_ERGOKEEB_CORNE_RIGHT
    def_bool $(shields_list_contains,ergokeeb_corne_right)
```
